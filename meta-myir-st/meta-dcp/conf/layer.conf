## meta-myir-st/meta-dcp/conf/layer.conf
```bitbake
# We have a conf and classes directory, add to BBPATH
BBPATH .= ":${LAYERDIR}"

# We have recipes-* directories, add to BBFILES
BBFILES += "${LAYERDIR}/recipes-*/*/*.bb \
            ${LAYERDIR}/recipes-*/*/*.bbappend"

BBFILE_COLLECTIONS += "meta-dcp"
BBFILE_PATTERN_meta-dcp = "^${LAYERDIR}/"
BBFILE_PRIORITY_meta-dcp = "7"

LAYERDEPENDS_meta-dcp = "core"
LAYERSERIES_COMPAT_meta-dcp = "dunfell"
```
